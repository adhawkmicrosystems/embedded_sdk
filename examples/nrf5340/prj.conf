## CMakeLists.txt
```
cmake_minimum_required(VERSION 3.20.0)

find_package(Zephyr REQUIRED HINTS $ENV{ZEPHYR_BASE})
project(adhawk_example)

get_filename_component(ROOT_DIR ../.. ABSOLUTE)

target_include_directories(app PRIVATE
    src/
    ${ROOT_DIR}/bsp/inc/
    ${ROOT_DIR}/inc/
    ${ROOT_DIR}/examples/common/
)

FILE(GLOB sdk_sources ${ROOT_DIR}/src/*.c)
FILE(GLOB zephyr_bsp_sources ${ROOT_DIR}/bsp/zephyr/*.c)
FILE(GLOB app_sources src/*.c ${ROOT_DIR}/examples/common/*.c)

target_sources(app PRIVATE
    ${sdk_sources}
    ${zephyr_bsp_sources}
    ${app_sources}
)
```

## prj.conf
```kconfig
CONFIG_LOG=y
CONFIG_USE_SEGGER_RTT=y

CONFIG_SPI=y
CONFIG_FPU=y
CONFIG_HEAP_MEM_POOL_SIZE=16384
CONFIG_SYSTEM_WORKQUEUE_STACK_SIZE=2048
CONFIG_TEST_RANDOM_GENERATOR=y

CONFIG_DYNAMIC_THREAD=y
CONFIG_DYNAMIC_THREAD_ALLOC=y

# For personalization APIs
# CONFIG_MAIN_STACK_SIZE=2048
# CONFIG_FLASH=y
# CONFIG_FLASH_MAP=y
# CONFIG_FLASH_PAGE_LAYOUT=y
# CONFIG_FILE_SYSTEM=y
# CONFIG_FILE_SYSTEM_LITTLEFS=y
```

## boards/nrf5340dk_nrf5340_cpuapp.overlay
```dts
/* For personalization APIs
/{
    fstab {
        compatible = "zephyr,fstab";
        flash_storage: lfs1 {
            compatible = "zephyr,fstab,littlefs";
            mount-point = "/ah_sdk";
            partition = <&storage_partition>;
            automount;
            read-size = <16>;
            prog-size = <16>;
            cache-size = <64>;
            lookahead-size = <32>;
            block-cycles = <512>;
        };
    };
};
*/
```

## src/main.c
```c
#include "example_common.h"

#include <zephyr/kernel.h>
#include <zephyr/logging/log.h>

LOG_MODULE_REGISTER(main);

int main(void)
{
    LOG_INF("Starting AdHawk SDK example");

    adhawk_example_run();

    while (true)
    {
        k_sleep(K_MSEC(1000));
    }

    return 0;
}
```
